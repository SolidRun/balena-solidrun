## layers/meta-balena-solidrun/conf/layer.conf
```bitbake
BBPATH .= ":${LAYERDIR}"

BBFILES += "${LAYERDIR}/recipes-*/*/*.bb \
            ${LAYERDIR}/recipes-*/*/*.bbappend"

BBFILE_COLLECTIONS += "balena-solidrun"
BBFILE_PATTERN_balena-solidrun := "^${LAYERDIR}/"
BBFILE_PRIORITY_balena-solidrun = "1337"

LAYERSERIES_COMPAT_balena-solidrun = "dunfell"
```

## layers/meta-balena-solidrun/conf/machine/n6gsdl.conf
```bitbake
#@TYPE: Machine
#@NAME: Solidrun n6gsdl
#@DESCRIPTION: Machine configuration for running on Solidsense

MACHINEOVERRIDES =. "mx6:mx6dl:mx6q:"

DEFAULTTUNE = "cortexa9thf-neon"
require conf/machine/include/imx-base.inc
require conf/machine/include/tune-cortexa9.inc

PREFERRED_PROVIDER_virtual/bootloader = "u-boot-solidsense-imx6"
PREFERRED_PROVIDER_virtual/kernel = "linux-imx"

UBOOT_MACHINE ?= "mx6cuboxi_defconfig"
UBOOT_MAKE_TARGET = "all"
UBOOT_SUFFIX = "img"
SPL_BINARY = "SPL"
WKS_FILE = "imx-uboot-spl.wks"

KERNEL_IMAGETYPE = "zImage"
KERNEL_DEVICETREE = " \
    imx6dl-hummingboard2-emmc-som-v15.dtb \
    imx6q-hummingboard2-emmc-som-v15.dtb \
"
MACHINE_FEATURES += "pci wifi bluetooth alsa irda serial usbhost"
MACHINE_EXTRA_RRECOMMENDS += "firmware-wireless-wilink8"

SERIAL_CONSOLE = "115200 ttymxc0"

MACHINE_ESSENTIAL_EXTRA_RDEPENDS += " \
    kernel-devicetree \
    n6g-scripts \
"
```
